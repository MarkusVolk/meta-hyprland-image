## conf/distro/hyprland-wayland.conf
```bitbake
require conf/distro/poky.conf

DISTRO = "hyprland-wayland"
DISTRO_NAME = "Hyprland (wayland)"
DISTRO_FEATURES_DEFAULT = " \
    acl \
    alsa \
    bluetooth \
    dbus \
    ext2 \
    gobject-introspection-data \
    gtk+3 \
    gtk4 \
    ipv4 \
    ipv6 \
    largefile \
    nfc \
    nfs \
    opengl \
    pam \
    pci \
    pcmcia \
    pipewire \
    polkit \
    pulseaudio \
    seccomp \
    systemd \
    tpm2 \
    usbgadget \
    usbhost \
    usrmerge \
    vfat \
    vulkan \
    wayland \
    wifi \
    x11 \
    xattr \
    xwayland \
    zeroconf \
"

DISTRO_FEATURES_BACKFILL:remove = "pulseaudio gobject-introspection-data ldconfig"
DISTRO_FEATURES_BACKFILL_CONSIDERED = "sysvinit"
DISTRO_FEATURES:remove = "sysvinit"

VIRTUAL-RUNTIME_init_manager = "systemd"
VIRTUAL-RUNTIME_login_manager = "systemd"
VIRTUAL-RUNTIME_dev_manager = "systemd"
VIRTUAL-RUNTIME_initscripts = "systemd-compat-units"

# Ensure the kernel nfs server is enabled
KERNEL_FEATURES:append:pn-linux-yocto = " features/nfsd/nfsd-enable.scc"

# Replace busybox
PREFERRED_PROVIDER_virtual/base-utils = "coreutils"
VIRTUAL-RUNTIME_base-utils = "coreutils"
VIRTUAL-RUNTIME_base-utils-hwclock = "util-linux-hwclock"
VIRTUAL-RUNTIME_base-utils-syslog = ""

# System configuration
PIPEWIRE_SESSION_MANAGER = "wireplumber"
WIRELESS_DAEMON = "iwd"

SERIAL_CONSOLES = ""
```

## conf/layer.conf
```bitbake
# We have a conf and classes directory, add to BBPATH
BBPATH .= ":${LAYERDIR}"

# We have recipes-* directories, add to BBFILES
BBFILES += "${LAYERDIR}/recipes-*/*/*.bb ${LAYERDIR}/recipes-*/*/*.bbappend"

BBFILE_COLLECTIONS += "hyprland-image"
BBFILE_PATTERN_hyprland-image = "^${LAYERDIR}/"
BBFILE_PRIORITY_hyprland-image = "7"

# This should only be incremented on significant changes that will
# cause compatibility issues with other layers
LAYERVERSION_hyprland-image = "1"
LAYERSERIES_COMPAT_hyprland-image = "mickledore nanbield"
LAYERDEPENDS_hyprland-image = "core"
```
